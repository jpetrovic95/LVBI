/**
 * @file oled_ssd1306.c
 * @brief SSD1306 OLED driver implementation.
 * @details
 *   Implements low-level commands over I2C and a simple text renderer.
 *   Provides initialization, clear, draw text, and sleep controls.
 */

#include "oled_ssd1306.h"
#include "esp_check.h"
#include "esp_log.h"
#include "hwa_i2c.h"
#include <string.h>

#define OLED_ADDR 0x3C
#define OLED_WIDTH 128
#define OLED_HEIGHT 32
#define OLED_PAGES (OLED_HEIGHT / 8)
#define FONT6X8_FIRST_CHAR 32 // ASCII character space (32)
#define FONT6X8_LAST_CHAR  122 // ASCII character 'z' (122)
#define FONT6X8_ASCII_SIZE 128

static const char *TAG = "OLED";
static int s_oled_fail_streak = 0; /* debounce consecutive failures */

const uint8_t font6x8[FONT6X8_ASCII_SIZE][6] = {
    [32] = {0x00, 0x00, 0x00, 0x00, 0x00, 0x00}, // sp
    [33] = {0x00, 0x00, 0x00, 0x2f, 0x00, 0x00}, // !
    [34] = {0x00, 0x00, 0x07, 0x00, 0x07, 0x00}, // "
    [35] = {0x00, 0x14, 0x7f, 0x14, 0x7f, 0x14}, // #
    [36] = {0x00, 0x24, 0x2a, 0x7f, 0x2a, 0x12}, // $
    [37] = {0x00, 0x62, 0x64, 0x08, 0x13, 0x23}, // %
    [38] = {0x00, 0x36, 0x49, 0x55, 0x22, 0x50}, // &
    [39] = {0x00, 0x00, 0x05, 0x03, 0x00, 0x00}, // '
    [40] = {0x00, 0x00, 0x1c, 0x22, 0x41, 0x00}, // (
    [41] = {0x00, 0x00, 0x41, 0x22, 0x1c, 0x00}, // )
    [42] = {0x00, 0x14, 0x08, 0x3E, 0x08, 0x14}, // *
    [43] = {0x00, 0x08, 0x08, 0x3E, 0x08, 0x08}, // +
    [44] = {0x00, 0x00, 0x00, 0xA0, 0x60, 0x00}, // ,
    [45] = {0x00, 0x08, 0x08, 0x08, 0x08, 0x08}, // -
    [46] = {0x00, 0x00, 0x60, 0x60, 0x00, 0x00}, // .
    [47] = {0x00, 0x20, 0x10, 0x08, 0x04, 0x02}, // /
    [48] = {0x00, 0x3E, 0x51, 0x49, 0x45, 0x3E}, // 0
    [49] = {0x00, 0x00, 0x42, 0x7F, 0x40, 0x00}, // 1
    [50] = {0x00, 0x42, 0x61, 0x51, 0x49, 0x46}, // 2
    [51] = {0x00, 0x21, 0x41, 0x45, 0x4B, 0x31}, // 3
    [52] = {0x00, 0x18, 0x14, 0x12, 0x7F, 0x10}, // 4
    [53] = {0x00, 0x27, 0x45, 0x45, 0x45, 0x39}, // 5
    [54] = {0x00, 0x3C, 0x4A, 0x49, 0x49, 0x30}, // 6
    [55] = {0x00, 0x01, 0x71, 0x09, 0x05, 0x03}, // 7
    [56] = {0x00, 0x36, 0x49, 0x49, 0x49, 0x36}, // 8
    [57] = {0x00, 0x06, 0x49, 0x49, 0x29, 0x1E}, // 9
    [58] = {0x00, 0x00, 0x36, 0x36, 0x00, 0x00}, // :
    [59] = {0x00, 0x00, 0x56, 0x36, 0x00, 0x00}, // ;
    [60] = {0x00, 0x08, 0x14, 0x22, 0x41, 0x00}, // <
    [61] = {0x00, 0x14, 0x14, 0x14, 0x14, 0x14}, // =
    [62] = {0x00, 0x00, 0x41, 0x22, 0x14, 0x08}, // >
    [63] = {0x00, 0x02, 0x01, 0x51, 0x09, 0x06}, // ?
    [64] = {0x00, 0x32, 0x49, 0x59, 0x51, 0x3E}, // @
    [65] = {0x00, 0x7C, 0x12, 0x11, 0x12, 0x7C}, // A
    [66] = {0x00, 0x7F, 0x49, 0x49, 0x49, 0x36}, // B
    [67] = {0x00, 0x3E, 0x41, 0x41, 0x41, 0x22}, // C
    [68] = {0x00, 0x7F, 0x41, 0x41, 0x22, 0x1C}, // D
    [69] = {0x00, 0x7F, 0x49, 0x49, 0x49, 0x41}, // E
    [70] = {0x00, 0x7F, 0x09, 0x09, 0x09, 0x01}, // F
    [71] = {0x00, 0x3E, 0x41, 0x49, 0x49, 0x7A}, // G
    [72] = {0x00, 0x7F, 0x08, 0x08, 0x08, 0x7F}, // H
    [73] = {0x00, 0x00, 0x41, 0x7F, 0x41, 0x00}, // I
    [74] = {0x00, 0x20, 0x40, 0x41, 0x3F, 0x01}, // J
    [75] = {0x00, 0x7F, 0x08, 0x14, 0x22, 0x41}, // K
    [76] = {0x00, 0x7F, 0x40, 0x40, 0x40, 0x40}, // L
    [77] = {0x00, 0x7F, 0x02, 0x0C, 0x02, 0x7F}, // M
    [78] = {0x00, 0x7F, 0x04, 0x08, 0x10, 0x7F}, // N
    [79] = {0x00, 0x3E, 0x41, 0x41, 0x41, 0x3E}, // O
    [80] = {0x00, 0x7F, 0x09, 0x09, 0x09, 0x06}, // P
    [81] = {0x00, 0x3E, 0x41, 0x51, 0x21, 0x5E}, // Q
    [82] = {0x00, 0x7F, 0x09, 0x19, 0x29, 0x46}, // R
    [83] = {0x00, 0x46, 0x49, 0x49, 0x49, 0x31}, // S
    [84] = {0x00, 0x01, 0x01, 0x7F, 0x01, 0x01}, // T
    [85] = {0x00, 0x3F, 0x40, 0x40, 0x40, 0x3F}, // U
    [86] = {0x00, 0x1F, 0x20, 0x40, 0x20, 0x1F}, // V
    [87] = {0x00, 0x3F, 0x40, 0x38, 0x40, 0x3F}, // W
    [88] = {0x00, 0x63, 0x14, 0x08, 0x14, 0x63}, // X
    [89] = {0x00, 0x07, 0x08, 0x70, 0x08, 0x07}, // Y
    [90] = {0x00, 0x61, 0x51, 0x49, 0x45, 0x43}, // Z
    [91] = {0x00, 0x00, 0x7F, 0x41, 0x41, 0x00}, // [
    [92] = {0x00, 0x55, 0x2A, 0x55, 0x2A, 0x55}, // '\'
    [93] = {0x00, 0x00, 0x41, 0x41, 0x7F, 0x00}, // ]
    [94] = {0x00, 0x04, 0x02, 0x01, 0x02, 0x04}, // ^
    [95] = {0x00, 0x40, 0x40, 0x40, 0x40, 0x40}, // _
    [96] = {0x00, 0x00, 0x01, 0x02, 0x04, 0x00}, // '
    [97] = {0x00, 0x20, 0x54, 0x54, 0x54, 0x78}, // a
    [98] = {0x00, 0x7F, 0x48, 0x44, 0x44, 0x38}, // b
    [99] = {0x00, 0x38, 0x44, 0x44, 0x44, 0x20}, // c
    [100] = {0x00, 0x38, 0x44, 0x44, 0x48, 0x7F}, // d
    [101] = {0x00, 0x38, 0x54, 0x54, 0x54, 0x18}, // e
    [102] = {0x00, 0x08, 0x7E, 0x09, 0x01, 0x02}, // f
    [103] = {0x00, 0x18, 0xA4, 0xA4, 0xA4, 0x7C}, // g
    [104] = {0x00, 0x7F, 0x08, 0x04, 0x04, 0x78}, // h
    [105] = {0x00, 0x00, 0x44, 0x7D, 0x40, 0x00}, // i
    [106] = {0x00, 0x40, 0x80, 0x84, 0x7D, 0x00}, // j
    [107] = {0x00, 0x7F, 0x10, 0x28, 0x44, 0x00}, // k
    [108] = {0x00, 0x00, 0x41, 0x7F, 0x40, 0x00}, // l
    [109] = {0x00, 0x7C, 0x04, 0x18, 0x04, 0x78}, // m
    [110] = {0x00, 0x7C, 0x08, 0x04, 0x04, 0x78}, // n
    [111] = {0x00, 0x38, 0x44, 0x44, 0x44, 0x38}, // o
    [112] = {0x00, 0xFC, 0x24, 0x24, 0x24, 0x18}, // p
    [113] = {0x00, 0x18, 0x24, 0x24, 0x18, 0xFC}, // q
    [114] = {0x00, 0x7C, 0x08, 0x04, 0x04, 0x08}, // r
    [115] = {0x00, 0x48, 0x54, 0x54, 0x54, 0x20}, // s
    [116] = {0x00, 0x04, 0x3F, 0x44, 0x40, 0x20}, // t
    [117] = {0x00, 0x3C, 0x40, 0x40, 0x20, 0x7C}, // u
    [118] = {0x00, 0x1C, 0x20, 0x40, 0x20, 0x1C}, // v
    [119] = {0x00, 0x3C, 0x40, 0x30, 0x40, 0x3C}, // w
    [120] = {0x00, 0x44, 0x28, 0x10, 0x28, 0x44}, // x
    [121] = {0x00, 0x1C, 0xA0, 0xA0, 0xA0, 0x7C}, // y
    [122] = {0x00, 0x44, 0x64, 0x54, 0x4C, 0x44}, // z
};

/**
 * @brief Send a command byte to the SSD1306 controller.
 *
 * @details
 *   Writes a single command byte over I2C to the OLED controller.
 *
 * @param[in] cmd Command byte to send.
 * @return ESP_OK on success, ESP_ERR_* on failure.
 */
static esp_err_t oled_ssd1306_send_command(uint8_t cmd);

esp_err_t oled_ssd1306_init(void) {
    /* Register device (harmless if already done; will log warning) */
    hwa_i2c_register_device("oled", OLED_ADDR);

    const uint8_t seq[] = {
        0xAE,       /* display off */
        0xD5, 0x80, /* clock divide */
        0xA8, 0x1F, /* multiplex for 128x32 (0x1F) */
        0xD3, 0x00, /* display offset */
        0x40,       /* start line */
        0x8D, 0x14, /* charge pump on */
        0x20, 0x00, /* horizontal addressing mode */
        0xA1,       /* segment remap */
        0xC8,       /* COM scan dec */
        0xDA, 0x02, /* COM pins cfg for 128x32 */
        0x81, 0x8F, /* contrast */
        0xD9, 0xF1, /* pre-charge */
        0xDB, 0x40, /* VCOM detect (0x40 ~ 0.77*Vcc) */
        0xA4,       /* display resume */
        0xA6,       /* normal (not inverted) */
        0xAF        /* display on */
    };

    for (size_t i = 0; i < sizeof(seq); ++i) {
        esp_err_t e = oled_ssd1306_send_command(seq[i]);
        if (e != ESP_OK) {
            ESP_LOGE(TAG, "Init command 0x%02X failed (%s)", seq[i], esp_err_to_name(e));
            if (++s_oled_fail_streak >= 2) {
                ESP_LOGE(TAG, "OLED I2C write failed (init seq)");
            }
            return e;
        }
    }
    ESP_LOGI(TAG, "OLED initialized");
    s_oled_fail_streak = 0;
    /* clear local failure streak on successful init */
    s_oled_fail_streak = 0;
    return ESP_OK;
}

void oled_ssd1306_clear(void) {

	uint8_t line[OLED_WIDTH + 1u] = {0x40}; // 0x40 is the data prefix for I2C
	for (uint8_t page = 0; page < OLED_PAGES; page++) {
		oled_ssd1306_send_command(0xB0 + page); // Set page address
		oled_ssd1306_send_command(0x00);		   // Column low address
		oled_ssd1306_send_command(0x10);		   // Column high address

		memset(&line[1u], 0x00, sizeof(line) - 1u); // Clear the line buffer
        // Write the cleared line to the OLED
        if (hwa_i2c_write("oled", line, sizeof(line)) != ESP_OK) {
            if (++s_oled_fail_streak >= 2) ESP_LOGE(TAG, "OLED draw: consecutive I2C errors (%d)", s_oled_fail_streak);
    } else { s_oled_fail_streak = 0; }
	}
}

void oled_ssd1306_draw_text(uint8_t x, uint8_t y, const char *text) {
	while (*text) {
		char c = *text++;
        if (c < 32 || c > 127) {
            c = 32; // Replace unsupported characters with space
            ESP_LOGW(TAG, "Unsupported character '%c' at position %d, replaced with space", c, *text - 1);
        }

		const uint8_t *glyph = font6x8[(uint8_t)c];
		if (!glyph) {
			text++;
			x += 6;	  // Move to next character position
			continue; // Skip if no glyph found
		}

		// Set page address
		oled_ssd1306_send_command(0xB0 + y);				 // Set page address
		oled_ssd1306_send_command(0x00 + (x & 0x0F));		 // Set low column address
		oled_ssd1306_send_command(0x10 + ((x >> 4) & 0x0F)); // Set high column address

		// Prepare 6-byte glyph + 1 control byte (0x40 for data stream)
		uint8_t data[7] = {0x40}; // First byte = control byte for data
		memcpy(&data[1], glyph, 6);

        if (hwa_i2c_write("oled", data, sizeof(data)) != ESP_OK) {
            if (++s_oled_fail_streak >= 2) ESP_LOGE(TAG, "OLED clear: consecutive I2C errors (%d)", s_oled_fail_streak);
    } else { s_oled_fail_streak = 0; }

		x += 6; // Move to next character position
		//text++;
	}
}

void oled_ssd1306_sleep(bool enable)
{
    uint8_t cmd[3];
    if (enable) {
        cmd[0] = 0x00;   /* control byte: command stream          */
        cmd[1] = 0xAE;   /* DISPLAY_OFF                           */
        cmd[2] = 0x8D;   /* CHARGE_PUMP                           */
    if (hwa_i2c_write("oled", cmd, 2) != ESP_OK) { if (++s_oled_fail_streak >= 2) ESP_LOGE(TAG, "OLED sleep cmd failed"); }          /* 0xAE only      */
        cmd[1] = 0x8D; cmd[2] = 0x10;            /* disable pump   */
    if (hwa_i2c_write("oled", cmd, 3) != ESP_OK) { if (++s_oled_fail_streak >= 2) ESP_LOGE(TAG, "OLED sleep seq step failed"); }
    } else {
        cmd[0] = 0x00;
        cmd[1] = 0x8D; cmd[2] = 0x14;            /* enable pump    */
    if (hwa_i2c_write("oled", cmd, 3) != ESP_OK) { if (++s_oled_fail_streak >= 2) ESP_LOGE(TAG, "OLED wake seq step failed"); }
        cmd[1] = 0xAF;                           /* DISPLAY_ON     */
    if (hwa_i2c_write("oled", cmd, 2) != ESP_OK) { if (++s_oled_fail_streak >= 2) ESP_LOGE(TAG, "OLED sleep state cmd failed"); }
    }
}

static esp_err_t oled_ssd1306_send_command(uint8_t cmd) {
	/*  Control byte for i2c
		Co : bit 8 : Continuation Bit
		* 1 = no-continuation (only one byte to follow)
		* 0 = the controller should expect a stream of bytes.
		D/C# : bit 7 : Data/Command Select bit
		* 1 = the next byte or byte stream will be Data.
		* 0 = a Command byte or byte stream will be coming up next.
		Bits 6-0 will be all zeros.
		Usage:
		0x80 : Single Command byte
		0x00 : Command Stream
		0xC0 : Single Data byte
		0x40 : Data Stream
	*/
    uint8_t buf[2] = {0x00, cmd};
    esp_err_t e = hwa_i2c_write("oled", buf, 2);
    if (e != ESP_OK) { if (++s_oled_fail_streak >= 2) ESP_LOGE(TAG, "OLED wake write failed"); }
    else { s_oled_fail_streak = 0; }
    return e;
}